## prj.conf
```kconfig
CONFIG_STDOUT_CONSOLE=y
CONFIG_I2C=y
CONFIG_SENSOR=y
CONFIG_LIS3MDL=y
CONFIG_LIS3MDL_TRIGGER=y
#CONFIG_LIS3MDL_TRIGGER_OWN_THREAD=y
```

## src/main.c
```c
/*
 * Copyright (c) 2017 Linaro Limited
 *
 * SPDX-License-Identifier: Apache-2.0
 */

#include <zephyr.h>
#include <device.h>
#include <sensor.h>
#include <stdio.h>
#include <misc/util.h>

#define DECIMATION_FACTOR	4
K_SEM_DEFINE(sem, 0, 1);	/* starts off "not available" */

static void trigger_handler(struct device *dev, struct sensor_trigger *trigger)
{
	static int decimator;
	ARG_UNUSED(trigger);

	/* Always fetch the sample to clear the data ready interrupt in the
	 * sensor.
	 */
	if (sensor_sample_fetch(dev)) {
		printf("sensor_sample_fetch failed\n");
		return;
	}

	/* Decimate the sensor data before printing to the console. There is
	 * not enough bandwidth on the UART at 115200 baud to print every
	 * sample.
	 */
	if (++decimator < DECIMATION_FACTOR) {
		return;
	}

	decimator = 0;

	k_sem_give(&sem);
}


void main(void)
{
	struct sensor_value accel[3];
	struct sensor_value magn[3];
	
	struct device *dev = device_get_binding("LIS3MDL");

	if (dev == NULL) {
		printf("Could not get LIS3MDL device\n");
		return;
	}
		struct sensor_trigger trig = {
		.type = SENSOR_TRIG_DATA_READY,
		.chan = SENSOR_CHAN_ACCEL_XYZ
	};
	
//	if (sensor_trigger_set(dev, &trig, trigger_handler)) {
//		printf("Could not set trigger\n");
//		return;
//	}



	while (1) {
		if (sensor_sample_fetch(dev) < 0) {
			printf("Sensor sample update error\n");
			return;
		}
	   	sensor_channel_get(dev, SENSOR_CHAN_ACCEL_XYZ, accel);
		sensor_channel_get(dev, SENSOR_CHAN_MAGN_XYZ, magn);


//		if (sensor_channel_get(dev, SENSOR_CHAN_TEMP, &temp) < 0) {
//			printf("Cannot read LIS3MDL temperature channel\n");
//			return;
//		}

//		if (sensor_channel_get(dev, SENSOR_CHAN_HUMIDITY, &hum) < 0) {
//			printf("Cannot read LIS3MDL humidity channel\n");
//			return;
//		}

        	/* Print accel x,y,z and mag x,y,z data */
		printf("AX=%10.6f AY=%10.6f AZ=%10.6f "
		       "MX=%10.6f MY=%10.6f MZ=%10.6f "
		       "T=%10.6f\n",
		       sensor_value_to_double(&accel[0]),
		       sensor_value_to_double(&accel[1]),
		       sensor_value_to_double(&accel[2]),
		       sensor_value_to_double(&magn[0]),
		       sensor_value_to_double(&magn[1]),
		       sensor_value_to_double(&magn[2]));
	
		k_sleep(2000);
	}
}
```
